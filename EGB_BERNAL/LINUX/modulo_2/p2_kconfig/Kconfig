## EGB_BERNAL/LINUX/modulo_2/p2_kconfig/Kconfig
```kconfig
config HELLO_VERBOSE
    bool "Mensajes detallados al cargar el modulo"
    default n
    help
      Si se activa, el modulo imprime un mensaje adicional
      al cargarse con informacion sobre la configuracion
      de compilacion.
```
